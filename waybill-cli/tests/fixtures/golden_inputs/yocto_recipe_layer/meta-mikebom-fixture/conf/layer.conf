## waybill-cli/tests/fixtures/golden_inputs/yocto_recipe_layer/meta-mikebom-fixture/conf/layer.conf
```bitbake
# Synthetic BBLAYERS layer.conf for the milestone-107 US4 recipe
# walker fixture. waybill does NOT parse this file in milestone 107
# (recipe walker is filename-only). Present so the directory layout
# looks authentic to anyone reading the fixture later.
BBPATH .= ":${LAYERDIR}"
BBFILE_COLLECTIONS += "waybill-fixture"
```

## waybill-cli/tests/fixtures/yocto_recipe_enrich/autoinc_version/conf/layer.conf
```bitbake
BBPATH .= ":${LAYERDIR}"
BBFILE_COLLECTIONS += "meta-fixture-autoinc"
LAYERVERSION_meta-fixture-autoinc = "1"
```

## waybill-cli/tests/fixtures/yocto_recipe_enrich/git_srcuri_srcrev/conf/layer.conf
```bitbake
BBPATH .= ":${LAYERDIR}"
BBFILE_COLLECTIONS += "meta-fixture-git"
LAYERVERSION_meta-fixture-git = "1"
```

## waybill-cli/tests/fixtures/yocto_recipe_enrich/include_chain/conf/layer.conf
```bitbake
BBPATH .= ":${LAYERDIR}"
BBFILE_COLLECTIONS += "meta-fixture-include"
LAYERVERSION_meta-fixture-include = "1"
```

## waybill-cli/tests/fixtures/yocto_recipe_enrich/multi_layer_polyglot/layer-a/conf/layer.conf
```bitbake
BBPATH .= ":${LAYERDIR}"
BBFILE_COLLECTIONS += "layer-a"
LAYERVERSION_layer-a = "2"
LAYERSERIES_COMPAT_layer-a = "scarthgap"
```

## waybill-cli/tests/fixtures/yocto_recipe_enrich/multi_layer_polyglot/layer-b/conf/layer.conf
```bitbake
BBPATH .= ":${LAYERDIR}"
BBFILE_COLLECTIONS += "layer-b"
LAYERVERSION_layer-b = "1"
```

## waybill-cli/tests/fixtures/yocto_recipe_enrich/orphan_bbappend/conf/layer.conf
```bitbake
BBFILE_COLLECTIONS += "meta-fixture-orphan"
LAYERVERSION_meta-fixture-orphan = "1"
```

## waybill-cli/tests/fixtures/yocto_recipe_enrich/single_layer_meta/conf/layer.conf
```bitbake
BBPATH .= ":${LAYERDIR}"
BBFILES += "${LAYERDIR}/recipes-*/*/*.bb"
BBFILE_COLLECTIONS += "meta-fixture-single"
BBFILE_PATTERN_meta-fixture-single := "^${LAYERDIR}/"
LAYERVERSION_meta-fixture-single = "1"
LAYERSERIES_COMPAT_meta-fixture-single = "scarthgap"
```
